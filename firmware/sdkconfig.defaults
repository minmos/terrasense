## firmware/sdkconfig.defaults
```kconfig
# --- Target Chip ---
CONFIG_IDF_TARGET="esp32c6"

# --- Partition Table Settings ---
CONFIG_PARTITION_TABLE_CUSTOM=y
CONFIG_PARTITION_TABLE_CUSTOM_FILENAME="partitions.csv"
CONFIG_PARTITION_TABLE_FILENAME="partitions.csv"

# --- Flash Storage ---
CONFIG_ESPTOOLPY_FLASHSIZE_8MB=y
CONFIG_ESPTOOLPY_FLASHSIZE="8MB"

# --- System Time Logging ---
CONFIG_LOG_TIMESTAMP_SOURCE_SYSTEM=y

# --- OTA ---
CONFIG_ESP_HTTPS_OTA_ALLOW_HTTP=y
```

## newFirmware/main/Kconfig.projbuild
```kconfig
# main/Kconfig.projbuild

menu "Terracotta Network Configuration"
    config WIFI_SSID
        string "WiFi SSID"
        default "yourWifiSSID"
        
    config WIFI_PASSWORD
        string "WiFi Password"
        default "supersecretpassword"

    config WIFI_HOSTNAME
        string "Device Hostname"
        default "yourdevicehostname"
        help
            The name this device will broadcast to the router (DHCP client name).
endmenu

menu "Terracotta MQTT Configuration"
    config MQTT_BROKER_URI
        string "MQTT Broker URI"
        default "mqtt://192.168.178.2:1883"
        help
            The full URI to your MQTT broker (e.g., mqtt://IP_ADDRESS:PORT).

endmenu

menu "Terrarium Configuration"

    choice TERRARIUM_TARGET
        prompt "Select Target Terrarium"
        default TEST_TERRARIUM
        help
            Select which terrarium this firmware is being built for. This will determine which app_logic and sys_config files are used.

        config TERRARIUM_TEST
            bool "Terrarium Test"
        
        config TERRARIUM_CRAWL_CAY
            bool "Terrarium Crawl Cay"
    endchoice

endmenu
```

## newFirmware/sdkconfig.defaults
```kconfig
# --- Target Chip ---
CONFIG_IDF_TARGET="esp32c6"

# --- Partition Table Settings ---
CONFIG_PARTITION_TABLE_CUSTOM=y
CONFIG_PARTITION_TABLE_CUSTOM_FILENAME="partitions.csv"
CONFIG_PARTITION_TABLE_FILENAME="partitions.csv"

# --- Flash Storage (16MB Boya Upgrade) ---
CONFIG_SPI_FLASH_SUPPORT_BOYA_CHIP=y
CONFIG_ESPTOOLPY_FLASHSIZE_16MB=y
CONFIG_ESPTOOLPY_FLASHSIZE="16MB"

# --- System Time Logging ---
CONFIG_LOG_TIMESTAMP_SOURCE_SYSTEM=y

# --- OTA ---
CONFIG_ESP_HTTPS_OTA_ALLOW_HTTP=y
```
